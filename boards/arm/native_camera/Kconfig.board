## boards/arm/native_camera/Kconfig.board
```kconfig
# BoSL nano board configuration

# Copyright (c) 2018-2020 Nordic Semiconductor ASA
# SPDX-License-Identifier: Apache-2.0

if SOC_NRF9160_SICA

config BOARD_NATIVE_CAMERA
	bool "Native Camera"

config BOARD_NATIVE_CAMERA_NS
	bool "Native Camera non-secure"

endif # SOC_NRF9160_SICA
```

## native_camera.move_to_board_def_dir/Kconfig.board
```kconfig
# BoSL nano board configuration

# Copyright (c) 2018-2020 Nordic Semiconductor ASA
# SPDX-License-Identifier: Apache-2.0

if SOC_NRF9160_SICA

config BOARD_NRF9160DK_NRF9160
	bool "Native Camera"

config BOARD_NRF9160DK_NRF9160_NS
	bool "Native Camera non-secure"

endif # SOC_NRF9160_SICA
```
